## samples/crypto/aes_cbc/sample.yaml
```yaml
sample:
    description: This app provides an example of performing AES encryption and
        decryption using AES CBC mode
    name: AES CBC example
tests:
    sample.aes_cbc:
        tags: introduction
        platform_allow: nrf5340dk_nrf5340_cpuappns nrf5340dk_nrf5340_cpuapp nrf9160dk_nrf9160ns nrf9160dk_nrf9160 nrf52840dk_nrf52840
        harness: console
        harness_config:
          type: multi_line
          regex:
            - ".*Example finished successfully!.*"

    sample.aes_cbc_cc3xx:
        tags: introduction
        platform_allow:  nrf5340dk_nrf5340_cpuapp nrf9160dk_nrf9160 nrf52840dk_nrf52840
        harness: console
        harness_config:
          type: multi_line
          regex:
            - ".*Example finished successfully!.*"
        extra_configs:
            - CONFIG_NORDIC_SECURITY_BACKEND=y
            - CONFIG_CC3XX_BACKEND=y
            - CONFIG_MBEDTLS_VANILLA_BACKEND=n
            - CONFIG_OBERON_BACKEND=n

    sample.aes_cbc_oberon:
        tags: introduction
        platform_allow:  nrf5340dk_nrf5340_cpuapp nrf9160dk_nrf9160 nrf52840dk_nrf52840
        harness: console
        harness_config:
          type: multi_line
          regex:
            - ".*Example finished successfully!.*"
        extra_configs:
            - CONFIG_NORDIC_SECURITY_BACKEND=y
            - CONFIG_CC3XX_BACKEND=n
            - CONFIG_MBEDTLS_VANILLA_BACKEND=n
            - CONFIG_OBERON_BACKEND=y

    sample.aes_cbc_multi:
        tags: introduction
        platform_allow:  nrf5340dk_nrf5340_cpuapp nrf9160dk_nrf9160 nrf52840dk_nrf52840
        harness: console
        harness_config:
          type: multi_line
          regex:
            - ".*Example finished successfully!.*"
        extra_configs:
            - CONFIG_NORDIC_SECURITY_BACKEND=y
            - CONFIG_CC3XX_BACKEND=y
            - CONFIG_MBEDTLS_VANILLA_BACKEND=y
            - CONFIG_OBERON_BACKEND=y

    sample.aes_cbc_cc3xx_oberon:
        tags: introduction
        platform_allow:  nrf5340dk_nrf5340_cpuapp nrf9160dk_nrf9160 nrf52840dk_nrf52840
        harness: console
        harness_config:
          type: multi_line
          regex:
            - ".*Example finished successfully!.*"
        extra_configs:
            - CONFIG_NORDIC_SECURITY_BACKEND=y
            - CONFIG_CC3XX_BACKEND=y
            - CONFIG_MBEDTLS_VANILLA_BACKEND=n
            - CONFIG_OBERON_BACKEND=y

    sample.aes_cbc_vanilla:
        tags: introduction
        platform_allow:  nrf5340dk_nrf5340_cpuapp nrf9160dk_nrf9160 nrf52840dk_nrf52840
        harness: console
        harness_config:
          type: multi_line
          regex:
            - ".*Example finished successfully!.*"
        extra_configs:
            - CONFIG_NORDIC_SECURITY_BACKEND=y
            - CONFIG_CC3XX_BACKEND=n
            - CONFIG_MBEDTLS_VANILLA_BACKEND=y
            - CONFIG_OBERON_BACKEND=n
```

## samples/crypto/hkdf/sample.yaml
```yaml
sample:
    description: HMAC key derivation function example
    name: HKDF example
tests:
    sample.hkdf:
        tags: introduction
        platform_allow: nrf5340dk_nrf5340_cpuappns nrf5340dk_nrf5340_cpuapp nrf9160dk_nrf9160ns nrf9160dk_nrf9160 nrf52840dk_nrf52840
        harness: console
        harness_config:
          type: multi_line
          regex:
            - ".*Example finished successfully!.*"

    sample.hkdf_cc3xx:
        tags: introduction
        platform_allow:  nrf5340dk_nrf5340_cpuapp nrf9160dk_nrf9160 nrf52840dk_nrf52840
        harness: console
        harness_config:
          type: multi_line
          regex:
            - ".*Example finished successfully!.*"
        extra_configs:
            - CONFIG_NORDIC_SECURITY_BACKEND=y
            - CONFIG_CC3XX_BACKEND=y
            - CONFIG_MBEDTLS_VANILLA_BACKEND=n
            - CONFIG_OBERON_BACKEND=n

    sample.hkdf_oberon:
        tags: introduction
        platform_allow:  nrf5340dk_nrf5340_cpuapp nrf9160dk_nrf9160 nrf52840dk_nrf52840
        harness: console
        harness_config:
          type: multi_line
          regex:
            - ".*Example finished successfully!.*"
        extra_configs:
            - CONFIG_NORDIC_SECURITY_BACKEND=y
            - CONFIG_CC3XX_BACKEND=n
            - CONFIG_MBEDTLS_VANILLA_BACKEND=n
            - CONFIG_OBERON_BACKEND=y

    sample.hkdf_multi:
        tags: introduction
        platform_allow:  nrf5340dk_nrf5340_cpuapp nrf9160dk_nrf9160 nrf52840dk_nrf52840
        harness: console
        harness_config:
          type: multi_line
          regex:
            - ".*Example finished successfully!.*"
        extra_configs:
            - CONFIG_NORDIC_SECURITY_BACKEND=y
            - CONFIG_CC3XX_BACKEND=y
            - CONFIG_MBEDTLS_VANILLA_BACKEND=y
            - CONFIG_OBERON_BACKEND=y

    sample.hkdf_cc3xx_oberon:
        tags: introduction
        platform_allow:  nrf5340dk_nrf5340_cpuapp nrf9160dk_nrf9160 nrf52840dk_nrf52840
        harness: console
        harness_config:
          type: multi_line
          regex:
            - ".*Example finished successfully!.*"
        extra_configs:
            - CONFIG_NORDIC_SECURITY_BACKEND=y
            - CONFIG_CC3XX_BACKEND=y
            - CONFIG_MBEDTLS_VANILLA_BACKEND=n
            - CONFIG_OBERON_BACKEND=y

    sample.hkdf_vanilla:
        tags: introduction
        platform_allow:  nrf5340dk_nrf5340_cpuapp nrf9160dk_nrf9160 nrf52840dk_nrf52840
        harness: console
        harness_config:
          type: multi_line
          regex:
            - ".*Example finished successfully!.*"
        extra_configs:
            - CONFIG_NORDIC_SECURITY_BACKEND=y
            - CONFIG_CC3XX_BACKEND=n
            - CONFIG_MBEDTLS_VANILLA_BACKEND=y
            - CONFIG_OBERON_BACKEND=n
```

## samples/crypto/hmac/sample.yaml
```yaml
sample:
    description: This app provides an example of performing HMAC signing and
        verification using the SHA256 hashing algorithm
        decryption using AES CBC mode
    name: HMAC example
tests:
    sample.hmac:
        tags: introduction
        platform_allow: nrf5340dk_nrf5340_cpuappns nrf5340dk_nrf5340_cpuapp nrf9160dk_nrf9160ns nrf9160dk_nrf9160 nrf52840dk_nrf52840
        harness: console
        harness_config:
          type: multi_line
          regex:
            - ".*Example finished successfully!.*"

    sample.hmac_cc3xx:
        tags: introduction
        platform_allow:  nrf5340dk_nrf5340_cpuapp nrf9160dk_nrf9160 nrf52840dk_nrf52840
        harness: console
        harness_config:
          type: multi_line
          regex:
            - ".*Example finished successfully!.*"
        extra_configs:
            - CONFIG_NORDIC_SECURITY_BACKEND=y
            - CONFIG_CC3XX_BACKEND=y
            - CONFIG_MBEDTLS_VANILLA_BACKEND=n
            - CONFIG_OBERON_BACKEND=n

    sample.hmac_oberon:
        tags: introduction
        platform_allow:  nrf5340dk_nrf5340_cpuapp nrf9160dk_nrf9160 nrf52840dk_nrf52840
        harness: console
        harness_config:
          type: multi_line
          regex:
            - ".*Example finished successfully!.*"
        extra_configs:
            - CONFIG_NORDIC_SECURITY_BACKEND=y
            - CONFIG_CC3XX_BACKEND=n
            - CONFIG_MBEDTLS_VANILLA_BACKEND=n
            - CONFIG_OBERON_BACKEND=y

    sample.hmac_multi:
        tags: introduction
        platform_allow:  nrf5340dk_nrf5340_cpuapp nrf9160dk_nrf9160 nrf52840dk_nrf52840
        harness: console
        harness_config:
          type: multi_line
          regex:
            - ".*Example finished successfully!.*"
        extra_configs:
            - CONFIG_NORDIC_SECURITY_BACKEND=y
            - CONFIG_CC3XX_BACKEND=y
            - CONFIG_MBEDTLS_VANILLA_BACKEND=y
            - CONFIG_OBERON_BACKEND=y

    sample.hmac_cc3xx_oberon:
        tags: introduction
        platform_allow:  nrf5340dk_nrf5340_cpuapp nrf9160dk_nrf9160 nrf52840dk_nrf52840
        harness: console
        harness_config:
          type: multi_line
          regex:
            - ".*Example finished successfully!.*"
        extra_configs:
            - CONFIG_NORDIC_SECURITY_BACKEND=y
            - CONFIG_CC3XX_BACKEND=y
            - CONFIG_MBEDTLS_VANILLA_BACKEND=n
            - CONFIG_OBERON_BACKEND=y

    sample.hmac_vanilla:
        tags: introduction
        platform_allow:  nrf5340dk_nrf5340_cpuapp nrf9160dk_nrf9160 nrf52840dk_nrf52840
        harness: console
        harness_config:
          type: multi_line
          regex:
            - ".*Example finished successfully!.*"
        extra_configs:
            - CONFIG_NORDIC_SECURITY_BACKEND=y
            - CONFIG_CC3XX_BACKEND=n
            - CONFIG_MBEDTLS_VANILLA_BACKEND=y
            - CONFIG_OBERON_BACKEND=n
```
