## prj.conf
```kconfig
#
# Copyright (c) 2021 Nordic Semiconductor ASA
#
# SPDX-License-Identifier: LicenseRef-Nordic-5-Clause
#

# Main thread
CONFIG_MAIN_STACK_SIZE=8192

# Logging
CONFIG_LOG=y
CONFIG_PRINTK=y
CONFIG_NET_LOG=y
CONFIG_LOG_DEFAULT_LEVEL=3
CONFIG_LOG_MODE_IMMEDIATE=y
CONFIG_LOG_ALWAYS_RUNTIME=y

# Networking
CONFIG_NETWORKING=y
CONFIG_NET_UDP=n
CONFIG_NET_TCP=y
CONFIG_NET_IPV6=n
CONFIG_NET_IPV4=y
CONFIG_NET_SOCKETS=y
CONFIG_NET_TCP_ISN_RFC6528=n
CONFIG_NET_CONFIG_SETTINGS=y
CONFIG_NET_CONFIG_NEED_IPV6=n
CONFIG_NET_CONFIG_NEED_IPV4=y
CONFIG_POSIX_API=y
CONFIG_NET_CONNECTION_MANAGER=n
CONFIG_NET_CONTEXT_NET_PKT_POOL=y

# TLS networking
CONFIG_ZVFS_OPEN_MAX=8
CONFIG_NET_SOCKETS_SOCKOPT_TLS=y
CONFIG_NET_SOCKETS_ENABLE_DTLS=n
CONFIG_NET_SOCKETS_TLS_MAX_CONTEXTS=6
CONFIG_NET_SOCKETS_TLS_MAX_CIPHERSUITES=16

# Network buffers
CONFIG_NET_MAX_CONTEXTS=6
CONFIG_NET_PKT_RX_COUNT=16
CONFIG_NET_PKT_TX_COUNT=16
CONFIG_NET_BUF_RX_COUNT=100
CONFIG_NET_BUF_TX_COUNT=100

# mbed TLS and security
CONFIG_MBEDTLS_PK_C=y

CONFIG_MBEDTLS_ENABLE_HEAP=y
CONFIG_MBEDTLS_HEAP_SIZE=50000
CONFIG_MBEDTLS_SSL_IN_CONTENT_LEN=2304
CONFIG_MBEDTLS_SSL_OUT_CONTENT_LEN=2304
CONFIG_MBEDTLS_SSL_CLI_C=y
CONFIG_MBEDTLS_TLS_LIBRARY=y
CONFIG_MBEDTLS_X509_LIBRARY=y

# NB: This list of PSA dependencies may be too long
CONFIG_PSA_WANT_GENERATE_RANDOM=y
CONFIG_PSA_WANT_KEY_TYPE_AES=y
CONFIG_PSA_WANT_ALG_CCM=y
CONFIG_PSA_WANT_ALG_GCM=y
CONFIG_PSA_WANT_ALG_CHACHA20_POLY1305=y
CONFIG_PSA_WANT_ALG_CMAC=y
CONFIG_PSA_WANT_ALG_HMAC=y
CONFIG_PSA_WANT_ALG_SHA_1=y
CONFIG_PSA_WANT_ALG_SHA_224=y
CONFIG_PSA_WANT_ALG_SHA_256=y
CONFIG_PSA_WANT_ALG_SHA_384=y
CONFIG_PSA_WANT_ALG_SHA_512=y
CONFIG_PSA_WANT_ALG_ECB_NO_PADDING=y
CONFIG_PSA_WANT_ALG_CBC_NO_PADDING=y
CONFIG_PSA_WANT_ALG_CBC_PKCS7=y
CONFIG_PSA_WANT_ALG_CTR=y
CONFIG_PSA_WANT_ALG_HKDF=y
CONFIG_PSA_WANT_ALG_TLS12_PRF=y
CONFIG_PSA_WANT_ALG_ECDH=y
CONFIG_PSA_WANT_ALG_ECDSA=y
CONFIG_PSA_WANT_ALG_DETERMINISTIC_ECDSA=y
CONFIG_PSA_WANT_ALG_JPAKE=y
CONFIG_PSA_WANT_ECC_SECP_R1_256=y
CONFIG_PSA_WANT_KEY_TYPE_ECC_KEY_PAIR_IMPORT=y
CONFIG_PSA_WANT_KEY_TYPE_ECC_KEY_PAIR_EXPORT=y
CONFIG_PSA_WANT_KEY_TYPE_ECC_KEY_PAIR_DERIVE=y
CONFIG_PSA_WANT_KEY_TYPE_ECC_KEY_PAIR_GENERATE=y
CONFIG_PSA_WANT_ALG_STREAM_CIPHER=y
CONFIG_PSA_WANT_KEY_TYPE_CHACHA20=y
CONFIG_PSA_WANT_ALG_TLS12_PSK_TO_MS=y

# RTT ethernet driver
CONFIG_ETH_RTT=y

# Optimizations
CONFIG_NO_OPTIMIZATIONS=y
CONFIG_NET_RX_STACK_SIZE=4096
CONFIG_NET_TX_STACK_SIZE=4096
CONFIG_NET_TCP_WORKQ_STACK_SIZE=8192
CONFIG_RESET_ON_FATAL_ERROR=n
CONFIG_NET_MGMT_EVENT_STACK_SIZE=8192

CONFIG_MBEDTLS_DEBUG=y
CONFIG_MBEDTLS_DEBUG_C=y

# Warnings and above
CONFIG_MBEDTLS_DEBUG_LEVEL=2
```

## boards/nrf5340dk_nrf5340_cpuapp_ns.conf
```kconfig
#
# Copyright (c) 2024 Nordic Semiconductor ASA
#
# SPDX-License-Identifier: LicenseRef-Nordic-5-Clause
#
CONFIG_TFM_PROFILE_TYPE_NOT_SET=y
CONFIG_NRF_ENABLE_ICACHE=n
CONFIG_MBEDTLS_USE_PSA_CRYPTO=y
CONFIG_MBEDTLS_PSA_CRYPTO_C=y

CONFIG_PM_PARTITION_SIZE_TFM=0x60000

CONFIG_DEBUG_OPTIMIZATIONS=y
CONFIG_NET_RX_STACK_SIZE=4096
CONFIG_NET_TX_STACK_SIZE=4096
CONFIG_NET_TCP_WORKQ_STACK_SIZE=8192
CONFIG_TFM_CMAKE_BUILD_TYPE_DEBUG=y
CONFIG_PM_PARTITION_SIZE_TFM=0x80000
```

## boards/nrf54l15dk_nrf54l15_cpuapp.conf
```kconfig
#
# Copyright (c) 2024 Nordic Semiconductor ASA
#
# SPDX-License-Identifier: LicenseRef-Nordic-5-Clause
#
# Optimizations
CONFIG_DEBUG_OPTIMIZATIONS=y
CONFIG_NET_RX_STACK_SIZE=4096
CONFIG_NET_TX_STACK_SIZE=4096
CONFIG_NET_TCP_WORKQ_STACK_SIZE=8192
```

## src/main.c
```c
/*
 * Copyright (c) 2021 Nordic Semiconductor ASA.
 *
 * SPDX-License-Identifier: LicenseRef-Nordic-5-Clause
 */

#include <nrf.h>
#include <zephyr/kernel.h>
#include <zephyr/logging/log.h>
#include <zephyr/net/tls_credentials.h>
#include "psa_tls_functions.h"
#include "psa_tls_credentials.h"
#include "certificate.h"
#include "dummy_psk.h"
#include "psa/crypto.h"
#include "mbedtls/debug.h"

LOG_MODULE_REGISTER(psa_tls_sample);


static int tls_set_preshared_key(void)
{
	LOG_INF("Registering Pre-shared key");

	int err = tls_credential_add(PSK_TAG, TLS_CREDENTIAL_PSK,
				     psk, sizeof(psk));
	if (err < 0) {
		LOG_ERR("Failed to register PSK: %d", err);
		return err;
	}
	err = tls_credential_add(PSK_TAG, TLS_CREDENTIAL_PSK_ID,
				 psk_id, strlen(psk_id));
	if (err < 0) {
		LOG_ERR("Failed to register PSK ID: %d", err);
		return err;
	}

	return APP_SUCCESS;
}


int main(void)
{
	int err;

	LOG_INF("PSA TLS app started");

	mbedtls_debug_set_threshold(CONFIG_MBEDTLS_DEBUG_LEVEL);

#if defined(MBEDTLS_USE_PSA_CRYPTO)
	err = psa_crypto_init();
	if (err < 0) {
		return APP_ERROR;
	}
#endif

	err = tls_set_credentials();
	if (err < 0) {
		return APP_ERROR;
	}

	err = tls_set_preshared_key();
	if (err < 0) {
		return APP_ERROR;
	}

	process_psa_tls();

	return APP_SUCCESS;
}
```

## src/psa_tls_functions_server.c
```c
/*
 * Copyright (c) 2021 Nordic Semiconductor ASA.
 *
 * SPDX-License-Identifier: LicenseRef-Nordic-5-Clause
 */

#include <zephyr/logging/log.h>
LOG_MODULE_REGISTER(psa_tls_server);

#include <nrf.h>
#include <errno.h>
#include <zephyr/kernel.h>
#include <zephyr/net/socket.h>
#include <zephyr/net/net_core.h>
#include <zephyr/net/tls_credentials.h>
#include <zephyr/linker/sections.h>

#include "certificate.h"
#include "psa_tls_functions.h"
#include "psa_tls_credentials.h"

static char recv_buffer[RECV_BUFFER_SIZE]; /* Buffer for storing payload */


/** @brief Function for setting up the server socket to use for TLS handshake.
 *
 * @returns The socket identifier.
 */
static int setup_tls_server_socket(void)
{
	int err;
	int sock;
	struct sockaddr_in my_addr;

	/* List of security tags to register. */
	sec_tag_t sec_tag_list[] = {
		SERVER_CERTIFICATE_TAG,
		PSK_TAG,
	};

	memset(&my_addr, 0, sizeof(my_addr));
	my_addr.sin_family = AF_INET;
	my_addr.sin_port = htons(SERVER_PORT);
	sock = socket(my_addr.sin_family, SOCK_STREAM, IPPROTO_TLS_1_2);

	err = setsockopt(sock, SOL_TLS, TLS_SEC_TAG_LIST, sec_tag_list,
			 sizeof(sec_tag_list));
	if (err < 0) {
		LOG_ERR("Failed to set TLS security TAG list. Err: %d", errno);
		(void)close(sock);
		return -errno;
	}

	err = bind(sock, (struct sockaddr *)&my_addr, sizeof(my_addr));
	if (err < 0) {
		LOG_ERR("Failed to bind TLS socket. Err: %d", errno);
		(void)close(sock);
		return -errno;
	}

	err = listen(sock, MAX_CLIENT_QUEUE);
	if (err < 0) {
		LOG_ERR("Failed to listen on TLS socket. Err: %d", errno);
		(void)close(sock);
		return -errno;
	}

	return sock;
}

/** @brief Thread function that handles all the steps of the TLS handshake for
 *  a server. Loops forever and accepts connections on the given port number.
 *
 */
void process_psa_tls(void)
{
	int err;
	int sock;
	int client;
	int received;
	struct sockaddr_in client_addr;
	socklen_t client_addr_len = sizeof(client_addr);

	while (true) {
		sock = setup_tls_server_socket();
		if (sock < 0) {
			LOG_INF("Retrying to create a socket");
			k_sleep(K_MSEC(1000));
			continue;
		}

		LOG_INF("Waiting for TLS connection on port %d ...",
			SERVER_PORT);
		client = accept(sock, (struct sockaddr *)&client_addr,
				&client_addr_len);

		if (client < 0) {
			LOG_ERR("TLS accept error (%d)", -errno);
			(void)close(sock);
			k_sleep(K_MSEC(1000));
			continue;
		}
		LOG_INF("Accepted TLS connection");

		while (true) {
			/* Try to receive data while connected */
			received = recv(client, recv_buffer,
					sizeof(recv_buffer), 0);

			if (received == 0) {
				/* Connection closed */
				LOG_INF("TLS Connection closed");
				break;

			} else if (received < 0) {
				/* Socket error */
				LOG_ERR("TLS Connection error: %d", errno);
				break;
			}

			LOG_INF("TLS received %d bytes", received);

			err = psa_tls_send_buffer(client, recv_buffer, received);
			if (err != 0) {
				LOG_ERR("TLS Failed to send. Err: %d", errno);
				break;
			}

			LOG_INF("TLS replied with %d bytes", received);
		}

		LOG_INF("Closing TLS connection");
		(void)close(client);
		(void)close(sock);

		// Give some time to properly close sockets before creating new ones
		k_sleep(K_MSEC(200));
	}
}
```
